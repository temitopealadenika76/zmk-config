## boards/shields/sk8key/Kconfig.shield
```kconfig
config SHIELD_SK8KEY_LEFT
    def_bool $(shields_list_contains,sk8key_left)

config SHIELD_SK8KEY_RIGHT
    def_bool $(shields_list_contains,sk8key_right)
```

## config/boards/shields/sk8key/Kconfig.defconfig
```kconfig
if SHIELD_SK8KEY

config ZMK_KEYBOARD_SK8KEY
    default "sk8key"
endif # SHIELD_SK8KEY

if ZMK_BACKLIGHT

config PWM
    default Y

config LED_PWM
    default Y

endif # ZMK_BACKLIGHT

if ZMK_DISPLAY

config I2C
    default y

config SSD1306
    default y

    select LV_USE_CONT
    select LV_FONT_MONTSERRAT_26
    select LV_FONT_MONTSERRAT_16
    select LV_USE_LABEL
    select LV_USE_IMG

config SSD1306_REVERSE_MODE
    bool
	default y

if LVGL

config LV_Z_VDB_SIZE

default 64

config LV_Z_DPI

default 148

config LV_Z_BITS_PER_PIXEL

default 1

choice LV_COLOR_DEPTH

default LV_COLOR_DEPTH_1

endchoice

endif # LVGL

# choice ZMK_DISPLAY_WORK_QUEUE
#     default ZMK_DISPLAY_WORK_QUEUE_DEDICATED

endif
```

## config/boards/shields/sk8key/Kconfig.shield
```kconfig
config ZMK_KEYBOARD_SK8KEY_LEFT
    def_bool $(shields_list_contains, sk8key_left)

config ZMK_KEYBOARD_SK8KEY_RIGHT
    def_bool $(shields_list_contains, sk8key_right)
```
